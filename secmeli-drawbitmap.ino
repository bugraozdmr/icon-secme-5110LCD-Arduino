#include <SPI.h>
#include <Adafruit_GFX.h>
#include <Adafruit_PCD8544.h>
//gerekli kutuphaneler

int buton1=11,buton2=10;

Adafruit_PCD8544 display = Adafruit_PCD8544(7, 6, 5, 4, 3);   //pcd8544 uretici

//bitmapleri tanimlayalim.

const unsigned char pikachu1[] PROGMEM = {
	0xff, 0xff, 0xff, 0xff, 0xff, 0xff, 0xff, 0xff, 0xff, 0xff, 0xf0, 0xff, 0xff, 0xff, 0xff, 0xff, 
	0xff, 0xff, 0xff, 0xff, 0xff, 0xf0, 0xff, 0xff, 0xff, 0xff, 0xff, 0xff, 0xff, 0xff, 0xff, 0xff, 
	0xf0, 0xff, 0xff, 0xff, 0xff, 0xff, 0xff, 0xff, 0xff, 0xff, 0xff, 0xf0, 0xff, 0xff, 0xff, 0xff, 
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	0xff, 0xff, 0xff, 0xff, 0xf0, 0xff, 0xff, 0xff, 0xff, 0xff, 0xff, 0xff, 0xff, 0xff, 0xff, 0xf0
};


const unsigned char ironman1[] PROGMEM ={
  0xff, 0xff, 0xff, 0xc7, 0xff, 0xff, 0xfe, 0x3f, 0xff, 0xff, 0xf0, 0xff, 0xff, 0xfe, 0x07, 0xff, 
	0xff, 0xfc, 0x07, 0xff, 0xff, 0xf0, 0xff, 0xff, 0xf0, 0x03, 0xff, 0xff, 0xfc, 0x00, 0xff, 0xff, 
	0xf0, 0xff, 0xff, 0xc0, 0x01, 0xff, 0xff, 0xf8, 0x00, 0x3f, 0xff, 0xf0, 0xff, 0xff, 0x00, 0x01, 
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	0xf0, 0x03, 0xff, 0xff, 0xf0, 0xff, 0xff, 0xff, 0x07, 0xff, 0xff, 0xfe, 0x0f, 0xff, 0xff, 0xf0
};

const unsigned char doggo1[] PROGMEM ={
  0xff, 0xff, 0xff, 0xff, 0xff, 0xff, 0xff, 0xff, 0xff, 0xff, 0xf0, 0xff, 0xff, 0xff, 0xff, 0xff, 
	0xff, 0xff, 0xff, 0xff, 0xff, 0xf0, 0xff, 0xff, 0xff, 0xff, 0xff, 0xff, 0xff, 0xff, 0xff, 0xff, 
	0xf0, 0xff, 0xff, 0xff, 0xff, 0xff, 0xff, 0xff, 0xff, 0xff, 0xff, 0xf0, 0xff, 0xff, 0xff, 0xff, 
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	0xff, 0xff, 0xff, 0xff, 0xf0, 0xff, 0xff, 0xff, 0xff, 0xff, 0xff, 0xff, 0xff, 0xff, 0xff, 0xf0
};

void setup() {
  //Initialize Display
  pinMode(buton1,INPUT);
  pinMode(buton2,INPUT);
  display.begin();
  display.clearDisplay();   //bu yapılmazsa basta cikan yildiz surekli cikar
  // you can change the contrast around to adapt the display for the best viewing!
  display.setContrast(100);
}
int k=1;
void loop() {
  display.setTextSize(1.6);
  display.setTextColor(BLACK);
  //1.butona basildiginda artacak
  if(digitalRead(buton1)==1) k++;
  //3 den sonra tekrar basarsa basa donsun
  if(k==4) k=1;
  if(k==1){
    display.println("=> pikachu");
    display.println("");
    display.println("ironman");
    display.println("");
    display.println("doggo");
    display.display();
    if(digitalRead(buton2)==1){
        display.clearDisplay();
        display.drawBitmap(0, 0,  pikachu1, 84, 48, BLACK);
        display.display();
        delay(5000);
        display.clearDisplay();
    }
    delay(100);
    display.clearDisplay();
  }
  else if(k==2){
    display.println("pikachu");
    display.println("");
    display.println("=> ironman");
    display.println("");
    display.println("doggo");
    display.display();
    if(digitalRead(buton2)==1){
      Serial.println("2.fonk");
      display.clearDisplay();
      display.drawBitmap(0, 0,ironman1, 84, 48, BLACK);
	    display.display();
      delay(5000);
      display.clearDisplay();
    }
    delay(100);
    display.clearDisplay();
  }
  else if(k==3){
    display.println("pikachu");
    display.println("");
    display.println("ironman");
    display.println("");
    display.println("=> doggo");
    display.display();
    if(digitalRead(buton2)==1){
      Serial.println("3.fonk");
      display.clearDisplay();
      display.drawBitmap(0, 0,  doggo1, 84, 48, BLACK);
	    display.display();
      delay(5000);
      display.clearDisplay();
    }
    delay(100);
    display.clearDisplay();
  }
  display.clearDisplay();
}
